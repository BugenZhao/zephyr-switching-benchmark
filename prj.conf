## CMakeLists.txt
```
# SPDX-License-Identifier: Apache-2.0

cmake_minimum_required(VERSION 3.20.0)

find_package(Zephyr REQUIRED HINTS $ENV{ZEPHYR_BASE})
project(myapp)

target_sources(app PRIVATE src/main.cc src/xip.cc src/preempt.cc src/fib.cc src/user_blinky.cc src/many_tasks.cc src/my_mutex.cc src/mutex.cc src/user_test.cc)
```

## prj.conf
```kconfig
CONFIG_USERSPACE=y
CONFIG_APPLICATION_DEFINED_SYSCALL=y
CONFIG_ARM_MPU=y
CONFIG_ASSERT=y
CONFIG_LOG=y
CONFIG_LOG_MODE_MINIMAL=y
CONFIG_MAIN_STACK_SIZE=2560
CONFIG_SPEED_OPTIMIZATIONS=y
CONFIG_GPIO=y
CONFIG_CPLUSPLUS=y
CONFIG_MAX_THREAD_BYTES=16
# CONFIG_THREAD_LOCAL_STORAGE=y
```

## src/main.c
```c
#include <drivers/gpio.h>
#include <stdio.h>
#include <sys/sem.h>
#include <zephyr.h>
#include "fib.h"
#include "preempt.h"
#include "xip.h"

#define THREAD_STACKSIZE 2048

struct k_thread thread;
K_THREAD_STACK_DEFINE(thread_stack, THREAD_STACKSIZE);

struct k_thread thread_2;
K_THREAD_STACK_DEFINE(thread_2_stack, THREAD_STACKSIZE);

void stat(bool user, void* func, int times) {
  while (times--) {
    uint32_t user_option = user ? K_USER : 0;

    int32_t cycle_start = sys_clock_cycle_get_32();

    k_thread_create(&thread, thread_stack, THREAD_STACKSIZE, func, NULL, NULL,
                    NULL, -1, K_INHERIT_PERMS | user_option, K_NO_WAIT);
    k_thread_join(&thread, K_FOREVER);

    uint32_t cycle_end = sys_clock_cycle_get_32();

    printf("start %10u, end %10u => %10u\n\n", cycle_start, cycle_end,
           cycle_end - cycle_start);
  }
}

void main_fib_bench() {
  const int BENCH_TIMES = 1;

  config_xip(false);

  for (int i = 0; i < 2; i++) {
    bool user = i % 2 == 0;
    stat(user, thread_function_sem_with_fib, BENCH_TIMES);
    stat(user, thread_function_fib_only, BENCH_TIMES);
    stat(user, thread_function_sem_only, BENCH_TIMES);

    k_msleep(1000);
    stat_xip_hit();
  }

  config_xip(true);

  for (int i = 0; i < 2; i++) {
    bool user = i % 2 == 0;
    stat(user, thread_function_sem_with_fib, BENCH_TIMES);
    stat(user, thread_function_fib_only, BENCH_TIMES);
    stat(user, thread_function_sem_only, BENCH_TIMES);

    k_msleep(1000);
    stat_xip_hit();
  }
}

void main_preempt() {
  k_thread_create(&thread, thread_stack, THREAD_STACKSIZE,
                  thread_function_blinky, NULL, NULL, NULL, -1, K_INHERIT_PERMS,
                  K_NO_WAIT);

  k_thread_create(&thread_2, thread_2_stack, THREAD_STACKSIZE,
                  thread_function_busy, NULL, NULL, NULL, 1, K_INHERIT_PERMS,
                  K_MSEC(2000));
}

void main(void) {
  printf("Welcome, %s!\n\n", CONFIG_BOARD);

  // main_fib_bench();
  main_preempt();
}
```

## src/main.cc
```c
#include <drivers/gpio.h>
#include <stdio.h>
#include <sys/sem.h>
#include <zephyr.h>
#include "common.h"
#include "fib.h"
#include "many_tasks.h"
#include "mutex.h"
#include "preempt.h"
#include "user_blinky.h"
#include "xip.h"
#include "user_test.h"

#define THREAD_STACKSIZE 2048

struct k_thread thread;
K_THREAD_STACK_DEFINE(thread_stack, THREAD_STACKSIZE);

struct k_thread thread_2;
K_THREAD_STACK_DEFINE(thread_2_stack, THREAD_STACKSIZE);

void bench(bool user, k_thread_entry_t func, int times) {
  do_bench(user, &thread, thread_stack, THREAD_STACKSIZE, func, -1, times);
}
void main_fib_bench() {
  const int BENCH_TIMES = 3;

  k_object_access_all_grant(&fib_k_sem);

  for (int i = 0; i < 2; i++) {
    bool user = i % 2 == 1;

    bench(user, thread_function_fib_only, BENCH_TIMES);
    // if (!user) {
    //   bench(user, thread_function_fib_with_thread_get_xip_clear,
    //   BENCH_TIMES);
    // }

    bench(user, thread_function_fib_with_k_sem, BENCH_TIMES);
    // bench(user, thread_function_k_sem_only, BENCH_TIMES);
    bench(user, thread_function_fib_with_sys_sem, BENCH_TIMES);

    // bench(user, thread_function_fib_with_thread_get, BENCH_TIMES);
    // bench(user, thread_function_thread_get_only, BENCH_TIMES);

    k_msleep(1000);
  }
}

void main_preempt() {
  k_thread_create(&thread, thread_stack, THREAD_STACKSIZE,
                  thread_function_blinky, NULL, NULL, NULL, -1, K_INHERIT_PERMS,
                  K_NO_WAIT);

  k_thread_create(&thread_2, thread_2_stack, THREAD_STACKSIZE,
                  thread_function_busy, NULL, NULL, NULL, 1, K_INHERIT_PERMS,
                  K_MSEC(2000));
}

#ifdef CONFIG_BOARD_RPI_PICO

K_SEM_DEFINE(blinky_sem, 0, 1);
void main_user_blinky() {
  static const struct gpio_dt_spec led =
      GPIO_DT_SPEC_GET(DT_ALIAS(led0), gpios);

  k_thread_access_grant(&thread, &blinky_sem, led.port);
  k_thread_create(&thread, thread_stack, THREAD_STACKSIZE,
                  thread_function_user_blinky_on_sem, &blinky_sem, (void*)&led,
                  NULL, -1, K_USER, K_NO_WAIT);

  k_thread_access_grant(&thread_2, &blinky_sem);
  k_thread_create(&thread_2, thread_2_stack, THREAD_STACKSIZE,
                  thread_function_user_give_sem, &blinky_sem, NULL, NULL, 1,
                  K_USER, K_MSEC(2000));
}

#endif

void main(void) {
  printf("Welcome, %s!\n\n", CONFIG_BOARD);

  // main_fib_bench();
  // main_preempt();
  // main_user_blinky();
  // many_tasks();
  mutex_bench();
  // mutex_test();
  // user_test();
}
```

## src/blink.c
```c
#include <drivers/gpio.h>
#include <stdio.h>
#include <zephyr.h>
#include <zephyr/sys/sem.h>

#define USER_STACKSIZE 2048

#define SLEEP_TIME_MS 250

#if defined(CONFIG_BOARD_RPI_PICO)

/* The devicetree node identifier for the "led0" alias. */
#define LED0_NODE DT_ALIAS(led0)

/*
 * A build error on this line means your board is unsupported.
 * See the sample documentation for information on how to fix this.
 */
static const struct gpio_dt_spec led = GPIO_DT_SPEC_GET(LED0_NODE, gpios);

void blinky(void) {
  int ret;

  if (!device_is_ready(led.port)) {
    return;
  }

  ret = gpio_pin_configure_dt(&led, GPIO_OUTPUT_ACTIVE);
  if (ret < 0) {
    return;
  }

  int count = 0;

  while (1) {
    count += 1;
    ret = gpio_pin_toggle_dt(&led);
    printf("Blink %d\n", count);
    if (ret < 0) {
      return;
    }
    k_msleep(SLEEP_TIME_MS);
  }
}
#else

void blinky(void) {
  while (1) {
    printf("Blink!\n");
    k_msleep(SLEEP_TIME_MS);
  }
}

#endif

struct k_thread thread;
K_THREAD_STACK_DEFINE(user_stack, USER_STACKSIZE);

static void user_function(void* p1, void* p2, void* p3) {
  printf("Hello World myapp from %s (%s)\n",
         k_is_user_context() ? "UserSpace!" : "privileged mode.", CONFIG_BOARD);

  if (k_is_user_context()) {
    k_msleep(1500);
  } else {
    return;
  }

  // __ASSERT(k_is_user_context(), "User mode execution was expected");
}

struct k_thread user_thread_3000;
K_THREAD_STACK_DEFINE(user_stack_3000, USER_STACKSIZE);

static void user_function_3000(void* p1, void* p2, void* p3) {
  printf("Hello World myapp 3000 from %s (%s)\n",
         k_is_user_context() ? "UserSpace!" : "privileged mode.", CONFIG_BOARD);

  if (k_is_user_context()) {
    k_msleep(1000);
  } else {
    return;
  }

  // __ASSERT(k_is_user_context(), "User mode execution was expected");
}

void main(void) {
  k_thread_create(&thread, user_stack, USER_STACKSIZE, user_function, NULL,
                  NULL, NULL, -1, K_INHERIT_PERMS | K_USER, K_NO_WAIT);
  k_thread_create(&user_thread_3000, user_stack_3000, USER_STACKSIZE,
                  user_function_3000, NULL, NULL, NULL, -1,
                  K_INHERIT_PERMS | K_USER, K_NO_WAIT);
  k_thread_join(&thread, K_FOREVER);
  k_thread_join(&user_thread_3000, K_FOREVER);

  blinky();
}
```

## src/common.h
```c
#ifndef MY_COMMON_H
#define MY_COMMON_H

#include <stdio.h>
#include <zephyr.h>
#include "xip.h"

#define print_current()           \
  printf("%s, in %s\n", __func__, \
         k_is_user_context() ? "user mode" : "kernel mode");

#define assert_user() \
  __ASSERT(k_is_user_context(), "%s not in the user context!", __func__);

#endif

inline void do_bench(bool user,
                     k_thread* thread,
                     k_thread_stack_t* stack,
                     size_t stack_size,
                     k_thread_entry_t func,
                     int prio,
                     int times) {
  printf("bench start...\n");
  clear_xip_cache();

  while (times--) {
    auto user_option = user ? K_USER : 0;

    k_thread_create(thread, stack, stack_size, func, NULL, NULL, NULL, prio,
                    K_INHERIT_PERMS | user_option, K_FOREVER);

    clear_xip_stat();

    auto cycle_start = sys_clock_cycle_get_32();

    k_thread_start(thread);
    k_thread_join(thread, K_FOREVER);

    auto cycle_end = sys_clock_cycle_get_32();

    printf("start %10u, end %10u => %10u\n", cycle_start, cycle_end,
           cycle_end - cycle_start);
    stat_xip_hit();
  }
  printf("bench end...\n\n");
}
```

## src/fib.cc
```c
#include "fib.h"
#include <stdio.h>
#include <sys/sem.h>
#include <zephyr.h>
#include "common.h"
#include "xip.h"

const int FIB_LEN = 128;
const int FIB_LOOP = 2000000;
const int SYSCALL_STEP = 1024;
const int SEM_LIMIT = FIB_LOOP / SYSCALL_STEP + 10;

K_SEM_DEFINE(fib_k_sem, 0, SEM_LIMIT);

void thread_function_fib_with_k_sem(void* p1, void* p2, void* p3) {
  print_current();
  k_sem_reset(&fib_k_sem);

  const int len = FIB_LEN;
  uint32_t fib[len];
  fib[0] = 0;
  fib[1] = 1;

  register int i = 2;
  for (; i < FIB_LOOP; ++i) {
    fib[i % len] = fib[(i + len - 1) % len] + fib[(i + len - 2) % len];

    if (i % SYSCALL_STEP == 0) {
      k_sem_give(&fib_k_sem);
    }
  }

  printf("done, fib[i] = %u, sem value = %u\n", fib[i % len],
         k_sem_count_get(&fib_k_sem));
}

#ifndef CONFIG_USERSPACE
SYS_SEM_DEFINE(sem, 0, SEM_LIMIT);
#endif

void thread_function_fib_with_sys_sem(void* p1, void* p2, void* p3) {
  print_current();

#ifdef CONFIG_USERSPACE
  SYS_SEM_DEFINE(sem, 0, SEM_LIMIT);
#endif

  const int len = FIB_LEN;
  uint32_t fib[len];
  fib[0] = 0;
  fib[1] = 1;

  register int i = 2;
  for (; i < FIB_LOOP; ++i) {
    fib[i % len] = fib[(i + len - 1) % len] + fib[(i + len - 2) % len];

    if (i % SYSCALL_STEP == 0) {
      sys_sem_give(&sem);
    }
  }

  printf("done, fib[i] = %u, sem value = %u\n", fib[i % len],
         sys_sem_count_get(&sem));
}

void thread_function_fib_only(void* p1, void* p2, void* p3) {
  print_current();

  register k_tid_t tid = NULL;

  const int len = FIB_LEN;
  uint32_t fib[len];
  fib[0] = 0;
  fib[1] = 1;

  register int i = 2;
  for (; i < FIB_LOOP; ++i) {
    fib[i % len] = fib[(i + len - 1) % len] + fib[(i + len - 2) % len];

    if (i % SYSCALL_STEP == 0) {
      tid = (k_tid_t)i;
    }
  }

  printf("done, fib[i] = %u, tid = %p\n", fib[i % len], tid);
}

void thread_function_k_sem_only(void* p1, void* p2, void* p3) {
  print_current();
  k_sem_reset(&fib_k_sem);

  register int i = 2;
  for (; i < FIB_LOOP; ++i) {
    if (i % SYSCALL_STEP == 0) {
      k_sem_give(&fib_k_sem);
    }
  }

  printf("done, sem value = %u\n", k_sem_count_get(&fib_k_sem));
}

void thread_function_fib_with_thread_get(void* p1, void* p2, void* p3) {
  print_current();

  register k_tid_t tid = NULL;

  const int len = FIB_LEN;
  uint32_t fib[len];
  fib[0] = 0;
  fib[1] = 1;

  register int i = 2;
  for (; i < FIB_LOOP; ++i) {
    fib[i % len] = fib[(i + len - 1) % len] + fib[(i + len - 2) % len];

    if (i % SYSCALL_STEP == 0) {
      tid = k_current_get();
    }
  }

  printf("done, fib[i] = %u, tid = %p\n", fib[i % len], tid);
}

void thread_function_fib_with_thread_get_xip_clear(void* p1,
                                                   void* p2,
                                                   void* p3) {
  print_current();

  register k_tid_t tid = NULL;

  const int len = FIB_LEN;
  uint32_t fib[len];
  fib[0] = 0;
  fib[1] = 1;

  register int i = 2;
  for (; i < FIB_LOOP; ++i) {
    fib[i % len] = fib[(i + len - 1) % len] + fib[(i + len - 2) % len];

    if (i % SYSCALL_STEP == 0) {
      tid = k_current_get();
      clear_xip_cache();
    }
  }

  printf("done, fib[i] = %u, tid = %p\n", fib[i % len], tid);
}

void thread_function_thread_get_only(void* p1, void* p2, void* p3) {
  print_current();

  register k_tid_t tid = NULL;

  register int i = 2;
  for (; i < FIB_LOOP; ++i) {
    if (i % SYSCALL_STEP == 0) {
      tid = k_current_get();
    }
  }

  printf("done, tid = %p\n", tid);
}
```

## src/fib.h
```c
#ifndef MY_FIB_H
#define MY_FIB_H

#include <zephyr.h>

extern struct k_sem fib_k_sem;

void thread_function_fib_with_k_sem(void* p1, void* p2, void* p3);

void thread_function_fib_with_sys_sem(void* p1, void* p2, void* p3);

void thread_function_fib_only(void* p1, void* p2, void* p3);

void thread_function_k_sem_only(void* p1, void* p2, void* p3);

void thread_function_fib_with_thread_get(void* p1, void* p2, void* p3);

void thread_function_fib_with_thread_get_xip_clear(void* p1, void* p2, void* p3);

void thread_function_thread_get_only(void* p1, void* p2, void* p3);

#endif
```

## src/many_tasks.cc
```c
#include "many_tasks.h"
#include <stdio.h>
#include <zephyr.h>
#include <zephyr/app_memory/app_memdomain.h>
#include "common.h"
#include "fib.h"

// #define MANY_TASKS_YIELD_COUNT

#ifdef MANY_TASKS_YIELD_COUNT
K_APPMEM_PARTITION_DEFINE(my_partition);
K_APP_BMEM(my_partition) uint32_t yield_count = 0;
#endif

void thread_function_always_yield(void* p1, void* p2, void* p3) {
  while (true) {
#ifdef MANY_TASKS_YIELD_COUNT
    yield_count += 1;
#endif
    k_yield();
  }
}

void thread_function_busy_work(void* p1, void* p2, void* p3) {
#ifdef MANY_TASKS_YIELD_COUNT
  yield_count = 0;
#endif
  thread_function_fib_only(p1, p2, p3);
#ifdef MANY_TASKS_YIELD_COUNT
  printf("yield count = %u\n", yield_count);
#endif
}

#include "spawn.cc.gen"

void many_tasks() {
#ifdef MANY_TASKS_YIELD_COUNT
  k_mem_domain domain;
  k_mem_partition* parts[] = {&my_partition};
  k_mem_domain_init(&domain, ARRAY_SIZE(parts), parts);

  k_mem_domain_add_thread(&domain, k_current_get());
#endif

  k_sched_time_slice_set(10, 1);
  printf("test with many tasks\n");

  auto yield_user = false;
  auto busy_user = false;

  spawn_many_tasks(yield_user);

  do_bench(busy_user, &thread_00, stack_00, sizeof(stack_00),
           thread_function_busy_work, 1, 5);
}
```

## src/many_tasks.h
```c
#ifndef MY_MANY_TASKS_H
#define MY_MANY_TASKS_H

void many_tasks();

#endif
```

## src/mutex.cc
```c
#include "mutex.h"
#include <stdio.h>
#include <sys/mutex.h>
#include <zephyr.h>
#include <zephyr/app_memory/app_memdomain.h>
#include "common.h"
#include "my_mutex.h"

K_APPMEM_PARTITION_DEFINE(my_partition);
K_APP_BMEM(my_partition) volatile uint32_t counter = 0;
K_APP_BMEM(my_partition) SYS_MUTEX_DEFINE(counter_sys_mutex);
K_APP_BMEM(my_partition) MY_MUTEX_DEFINE(counter_my_mutex);

#define LOCK_TIMES 100000

void thread_function_sys_mutex(void* p1, void* p2, void* p3) {
  print_current();
  counter = 0;

  int ret;
  bool end = false;

#ifdef CONFIG_THREAD_LOCAL_STORAGE
  register k_tid_t tid = 0;
#else
  register k_tid_t tid = k_current_get();
#endif

  while (true) {
    ret = sys_mutex_lock(&counter_sys_mutex, K_FOREVER);
    // __ASSERT(ret == 0, "failed to lock mutex");

    counter += 1;
    end = counter >= LOCK_TIMES;

    ret = sys_mutex_unlock(&counter_sys_mutex);
    // __ASSERT(ret == 0, "failed to unlock mutex");

    if (unlikely(end)) {
      break;
    }
  }

  printf("done. tid = %p, counter = %u\n", tid, counter);
}

void thread_function_my_mutex(void* p1, void* p2, void* p3) {
  print_current();
  counter = 0;

  int ret;
  bool end = false;

#ifdef CONFIG_THREAD_LOCAL_STORAGE
  register k_tid_t tid = 0;
#else
  register k_tid_t tid = k_current_get();
#endif

  while (true) {
#ifdef CONFIG_THREAD_LOCAL_STORAGE
    ret = my_mutex_lock(&counter_my_mutex, K_FOREVER);
#else
    ret = my_mutex_lock(&counter_my_mutex, tid, K_FOREVER);
#endif
    // __ASSERT(ret == 0, "failed to lock mutex");

    counter += 1;
    end = counter >= LOCK_TIMES;

#ifdef CONFIG_THREAD_LOCAL_STORAGE
    ret = my_mutex_unlock(&counter_my_mutex);
#else
    ret = my_mutex_unlock(&counter_my_mutex, tid);
#endif
    // __ASSERT(ret == 0, "failed to unlock mutex");

    if (unlikely(end)) {
      break;
    }
  }

  printf("done. tid = %p, counter = %u\n", tid, counter);
}

void thread_function_no_mutex(void* p1, void* p2, void* p3) {
  print_current();
  counter = 0;

  bool end = false;

#ifdef CONFIG_THREAD_LOCAL_STORAGE
  register k_tid_t tid = 0;
#else
  register k_tid_t tid = k_current_get();
#endif

  while (true) {
    counter += 1;
    end = counter >= LOCK_TIMES;

    if (unlikely(end)) {
      break;
    }
  }

  printf("done. tid = %p, counter = %u\n", tid, counter);
}

void thread_function_my_mutex_test(void* p1, void* p2, void* p3) {
  register auto tid = k_current_get();

  int ret;

  auto sleep_ms = (int32_t)(intptr_t)p1;
  if (sleep_ms > 0) {
    k_msleep(sleep_ms);
  }

  ret = my_mutex_lock(&counter_my_mutex, tid, K_FOREVER);
  __ASSERT(ret == 0, "failed to lock mutex");

  k_msleep(200);

  ret = my_mutex_unlock(&counter_my_mutex, tid);
  __ASSERT(ret == 0, "failed to unlock mutex");
}

struct k_thread mutex_thread_00;
K_THREAD_STACK_DEFINE(mutex_stack_00, 1024);

struct k_thread mutex_thread_01;
K_THREAD_STACK_DEFINE(mutex_stack_01, 1024);

struct k_thread mutex_thread_02;
K_THREAD_STACK_DEFINE(mutex_stack_02, 1024);

struct k_thread mutex_thread_03;
K_THREAD_STACK_DEFINE(mutex_stack_03, 1024);

struct k_thread mutex_thread_98;
K_THREAD_STACK_DEFINE(mutex_stack_98, 1024);

struct k_thread mutex_thread_99;
K_THREAD_STACK_DEFINE(mutex_stack_99, 1024);

#define configure_domain()                                \
  {                                                       \
    k_mem_domain domain;                                  \
    k_mem_partition* parts[] = {&my_partition};           \
    k_mem_domain_init(&domain, ARRAY_SIZE(parts), parts); \
    k_mem_domain_add_thread(&domain, k_current_get());    \
  }

void mutex_bench() {
  const auto times = 10;

  configure_domain();

  do_bench(false, &mutex_thread_98, mutex_stack_98, 1024,
           thread_function_no_mutex, -1, times);
  do_bench(true, &mutex_thread_99, mutex_stack_99, 1024,
           thread_function_no_mutex, -1, times);

  do_bench(false, &mutex_thread_00, mutex_stack_00, 1024,
           thread_function_my_mutex, -1, times);
  do_bench(false, &mutex_thread_01, mutex_stack_01, 1024,
           thread_function_sys_mutex, -1, times);
  do_bench(true, &mutex_thread_02, mutex_stack_02, 1024,
           thread_function_my_mutex, -1, times);
  do_bench(true, &mutex_thread_03, mutex_stack_03, 1024,
           thread_function_sys_mutex, -1, times);
}

void mutex_test() {
  configure_domain();

  k_thread_create(&mutex_thread_00, mutex_stack_00, 1024,
                  thread_function_my_mutex_test, (void*)0, NULL, NULL, -1,
                  K_USER | K_INHERIT_PERMS, K_NO_WAIT);

  k_thread_create(&mutex_thread_01, mutex_stack_01, 1024,
                  thread_function_my_mutex_test, (void*)50, NULL, NULL, -1,
                  K_USER | K_INHERIT_PERMS, K_NO_WAIT);

  k_thread_create(&mutex_thread_02, mutex_stack_02, 1024,
                  thread_function_my_mutex_test, (void*)100, NULL, NULL, -1,
                  K_USER | K_INHERIT_PERMS, K_NO_WAIT);

  k_thread_join(&mutex_thread_00, K_FOREVER);
  k_thread_join(&mutex_thread_01, K_FOREVER);
  k_thread_join(&mutex_thread_02, K_FOREVER);

  printf("mutex test done\n");
}
```

## src/mutex.h
```c
#ifndef MY_MUTEX_H
#define MY_MUTEX_H

void mutex_bench();

void mutex_test();

#endif
```

## src/my_mutex.cc
```c
#include "my_mutex.h"
#include <stdio.h>

// #define MY_MUTEX_LOG

#ifdef MY_MUTEX_LOG
#define mutex_log(fmt, ...) printf("" fmt, ##__VA_ARGS__)
#else
#define mutex_log(fmt, ...)
#endif

int my_mutex_lock(struct my_mutex* mutex, k_tid_t tid, k_timeout_t timeout) {
  auto tid_val = (atomic_val_t)tid;
  int ret = 0;

  // Fast path for uncontended mutex.
  if (likely(atomic_cas(&mutex->futex.val, MY_MUTEX_UNCONTENDED, tid_val))) {
    mutex_log("lock(%p): fast path, uncountended, done\n", tid);
    return 0;
  }

  while (true) {
    atomic_val_t old_val = atomic_get(&mutex->futex.val);
    if (old_val == MY_MUTEX_UNCONTENDED) {
      if (!likely(atomic_cas(&mutex->futex.val, old_val, tid_val))) {
        mutex_log("lock(%p): cas retry\n", tid);
        continue;
      }
      mutex_log("lock(%p): uncountended\n", tid);
    } else {
      if ((old_val & 0x1) == 0) {  // no waiting
        if (!likely(atomic_cas(&mutex->futex.val, old_val, old_val | 0x1))) {
          mutex_log("lock(%p): cas retry\n", tid);
          continue;
        }
        mutex_log("lock(%p): countended, mark waiting bit\n", tid);
      } else {
        mutex_log("lock(%p): countended, waiting bit already marked\n", tid);
      }
      mutex_log("lock(%p): start to wait\n", tid);
      ret = k_futex_wait(&mutex->futex, old_val | 0x1, timeout);
      if (likely(ret == 0 || ret == -EAGAIN)) {
        mutex_log("lock(%p): wait ok, retry locking\n", tid);
        continue;
      }
    }

    break;
  }

  mutex_log("lock(%p): done\n", tid);

  return ret;
}

int my_mutex_unlock(struct my_mutex* mutex, k_tid_t tid) {
  auto tid_val = (atomic_val_t)tid;
  int ret = 0;

  // Fast path for no waiting threads.
  if (likely(atomic_cas(&mutex->futex.val, tid_val, MY_MUTEX_UNCONTENDED))) {
    mutex_log("unlock(%p): fast path, no waiting, done\n", tid);
    return 0;
  }

  while (true) {
    atomic_val_t old_val = atomic_get(&mutex->futex.val);
    if (likely(old_val == (tid_val | 0x1))) {
      if (!likely(
              atomic_cas(&mutex->futex.val, old_val, MY_MUTEX_UNCONTENDED))) {
        mutex_log("unlock(%p): cas retry\n", tid);
        continue;
      }
      ret = k_futex_wake(&mutex->futex, true);
      mutex_log("unlock(%p): has waiting, waked\n", tid);
    } else if (old_val == tid_val) {
      if (!likely(
              atomic_cas(&mutex->futex.val, old_val, MY_MUTEX_UNCONTENDED))) {
        mutex_log("unlock(%p): cas retry\n", tid);
        continue;
      }
      mutex_log("unlock(%p): no waiting\n", tid);
    } else if (old_val == MY_MUTEX_UNCONTENDED) {
      ret = -EINVAL;
    } else {
      ret = -EPERM;
    }

    break;
  }

  mutex_log("unlock(%p): done\n", tid);

  if (likely(ret >= 0)) {
    return 0;
  }
  return ret;
}
```

## src/my_mutex.h
```c
#ifndef MY_MY_MUTEX_H
#define MY_MY_MUTEX_H

#include <sys/atomic.h>
#include <zephyr.h>
#include <zephyr/types.h>

#define MY_MUTEX_UNCONTENDED 0

struct my_mutex {
  struct k_futex futex;
};

#define MY_MUTEX_DEFINE(_name) \
  struct my_mutex _name = {.futex = {MY_MUTEX_UNCONTENDED}}

int my_mutex_lock(struct my_mutex* mutex, k_tid_t tid, k_timeout_t timeout);

int my_mutex_unlock(struct my_mutex* mutex, k_tid_t tid);

#ifdef CONFIG_THREAD_LOCAL_STORAGE

inline int my_mutex_lock(struct my_mutex* mutex, k_timeout_t timeout) {
  return my_mutex_lock(mutex, k_current_get(), timeout);
}

inline int my_mutex_unlock(struct my_mutex* mutex) {
  return my_mutex_unlock(mutex, k_current_get());
}

#endif

#endif
```

## src/preempt.cc
```c
#include "preempt.h"
#include <drivers/gpio.h>
#include <stdio.h>
#include <zephyr.h>

void thread_function_blinky(void* p1, void* p2, void* p3) {
#ifdef CONFIG_BOARD_RPI_PICO

  static const struct gpio_dt_spec led =
      GPIO_DT_SPEC_GET(DT_ALIAS(led0), gpios);

  int ret = 0;

  ret = device_is_ready(led.port);
  __ASSERT(ret, "led is not ready");

  ret = gpio_pin_configure_dt(&led, GPIO_OUTPUT_ACTIVE);
  __ASSERT(ret == 0, "failed to configure led");

  while (true) {
    gpio_pin_toggle_dt(&led);
    printf("led toggle\n");
    k_msleep(250);
  }

#endif
}

void thread_function_busy(void* p1, void* p2, void* p3) {
  volatile uint32_t a = 0;
  while (true) {
    if (a % (1 << 22) == 0) {
      printf("busy %x\n", a);
    }
    a += 1;
  }
}
```
